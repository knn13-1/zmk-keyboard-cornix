## boards/jzf/cornix/cornix_left_defconfig
```kconfig
# e73 config

CONFIG_ADC_NRFX_SAADC=y

# Enable MPU
CONFIG_ARM_MPU=y

CONFIG_PINCTRL=y

# enable GPIO
CONFIG_GPIO=y

CONFIG_USE_DT_CODE_PARTITION=y
CONFIG_BUILD_OUTPUT_UF2=y

CONFIG_MPU_ALLOW_FLASH_WRITE=y

CONFIG_NVS=y
CONFIG_SETTINGS_NVS=y

CONFIG_FLASH=y
CONFIG_FLASH_PAGE_LAYOUT=y
CONFIG_FLASH_MAP=y

CONFIG_CLOCK_CONTROL_NRF=y
CONFIG_CLOCK_CONTROL_NRF_K32SRC_RC=y

# e73 config end

CONFIG_ZMK_KEYBOARD_NAME="Cornix"

# Left side is no longer the central side
CONFIG_ZMK_USB=n
CONFIG_ZMK_SPLIT=y

# Increase BLE radio transmit power to help with latency / split communication
CONFIG_BT_CTLR_TX_PWR_PLUS_8=y

# Battery report interval, in seconds
CONFIG_ZMK_BATTERY_REPORT_INTERVAL=60

CONFIG_PINCTRL=y

# RGB
CONFIG_SPI=n

CONFIG_EC11=y
CONFIG_EC11_TRIGGER_GLOBAL_THREAD=y

# enable display drivers
CONFIG_ZMK_DISPLAY=n

# BLE passkey
CONFIG_ZMK_BLE_PASSKEY_ENTRY=n

# BLE clean
CONFIG_ZMK_BLE_CLEAR_BONDS_ON_START=n

CONFIG_ZMK_HID_REPORT_TYPE_NKRO=n

CONFIG_ZMK_POINTING=y

# vim: set ft=kconfig:
```

## boards/jzf/cornix/cornix_right_defconfig
```kconfig
# SPDX-License-Identifier: MIT

CONFIG_ADC_NRFX_SAADC=y

# Enable MPU
CONFIG_ARM_MPU=y

# Use pinctrl
CONFIG_PINCTRL=y

# enable GPIO
CONFIG_GPIO=y

CONFIG_USE_DT_CODE_PARTITION=y
CONFIG_BUILD_OUTPUT_UF2=y

CONFIG_MPU_ALLOW_FLASH_WRITE=y
CONFIG_NVS=y
CONFIG_SETTINGS_NVS=y
CONFIG_FLASH=y
CONFIG_FLASH_PAGE_LAYOUT=y
CONFIG_FLASH_MAP=y
CONFIG_CLOCK_CONTROL_NRF=y
CONFIG_CLOCK_CONTROL_NRF_K32SRC_RC=y

CONFIG_ZMK_KEYBOARD_NAME="Cornix"

CONFIG_ZMK_SPLIT=y
CONFIG_ZMK_SPLIT_ROLE_CENTRAL=y

CONFIG_ZMK_BLE=y
CONFIG_ZMK_USB=y

# Temporarily clear old BLE bonds
CONFIG_ZMK_BLE_CLEAR_BONDS_ON_START=y

# Increase BLE radio transmit power
CONFIG_BT_CTLR_TX_PWR_PLUS_8=y

# Battery report interval
CONFIG_ZMK_BATTERY_REPORT_INTERVAL=60

CONFIG_INPUT=y

CONFIG_EC11=y
CONFIG_EC11_TRIGGER_GLOBAL_THREAD=y

CONFIG_ZMK_HID_REPORT_TYPE_NKRO=n
CONFIG_ZMK_POINTING=y

# 3 profiles
CONFIG_BT_MAX_CONN=6
CONFIG_BT_MAX_PAIRED=6

CONFIG_ZMK_SPLIT_BLE_CENTRAL_BATTERY_LEVEL_PROXY=y
CONFIG_ZMK_SPLIT_BLE_CENTRAL_BATTERY_LEVEL_FETCHING=y

# ZMK Studio
CONFIG_ZMK_STUDIO=y
CONFIG_ZMK_STUDIO_LOCKING=n
CONFIG_ZMK_STUDIO_LOCK_ON_DISCONNECT=n

# vim: set ft=kconfig:
```
