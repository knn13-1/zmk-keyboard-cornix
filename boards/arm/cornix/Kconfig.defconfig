## boards/arm/cornix/Kconfig.defconfig
```kconfig
# Cornix common defaults for ZMK split
# 放在共用處，但只在「中央端（Central）」時才開啟對應功能，
# 以免編左半（Peripheral）時連結出錯。

if ZMK_SPLIT

menu "Cornix split defaults"

# 只有當前這個 build 被編成 Central 時才套用
if ZMK_SPLIT_ROLE_CENTRAL

# 中央端才需要從外側讀取電池電量的代理功能
config ZMK_SPLIT_BLE_CENTRAL_BATTERY_LEVEL_PROXY
    default y

config ZMK_SPLIT_BLE_CENTRAL_BATTERY_LEVEL_FETCHING
    default y

endif  # ZMK_SPLIT_ROLE_CENTRAL

endmenu

endif  # ZMK_SPLIT
```

## boards/arm/cornix/cornix_left_defconfig
```kconfig
# e73 config
CONFIG_SOC_SERIES_NRF52X=y
CONFIG_SOC_NRF52840_QIAA=y

# Cornix left board
CONFIG_BOARD_CORNIX_LEFT=y

CONFIG_ADC_NRFX_SAADC=y
CONFIG_ARM_MPU=y
CONFIG_PINCTRL=y
CONFIG_GPIO=y
CONFIG_USE_DT_CODE_PARTITION=y
CONFIG_BUILD_OUTPUT_UF2=y
CONFIG_MPU_ALLOW_FLASH_WRITE=y
CONFIG_NVS=y
CONFIG_SETTINGS_NVS=y
CONFIG_FLASH=y
CONFIG_FLASH_PAGE_LAYOUT=y
CONFIG_FLASH_MAP=y
CONFIG_CLOCK_CONTROL_NRF=y
CONFIG_CLOCK_CONTROL_NRF_K32SRC_RC=y
# e73 config end

# ZMK
CONFIG_ZMK_KEYBOARD_NAME="Cornix"
CONFIG_ZMK_BLE=y
CONFIG_ZMK_USB=n            # 左半通常不需要 USB

# Split：左半是 Peripheral（不要設 CENTRAL）
CONFIG_ZMK_SPLIT=y
# 記住：ZMK 沒有 CONFIG_ZMK_SPLIT_ROLE_PERIPHERAL；保持「不設 CENTRAL」即為 Peripheral

# 連線/顯示/其他（依你原設定）
CONFIG_BT_CTLR_TX_PWR_PLUS_8=y
CONFIG_SPI=n
CONFIG_ZMK_DISPLAY=n
CONFIG_ZMK_BLE_PASSKEY_ENTRY=n
CONFIG_ZMK_BLE_CLEAR_BONDS_ON_START=n
CONFIG_ZMK_HID_REPORT_TYPE_NKRO=n
CONFIG_ZMK_POINTING=y
CONFIG_BT_MAX_CONN=6
CONFIG_BT_MAX_PAIRED=6
CONFIG_ZMK_STUDIO=y
CONFIG_ZMK_STUDIO_LOCKING=n
CONFIG_ZMK_STUDIO_LOCK_ON_DISCONNECT=n
```

## boards/arm/cornix/cornix_right_defconfig
```kconfig
# ===== SoC / Board 基本 =====
CONFIG_SOC_SERIES_NRF52X=y
CONFIG_SOC_NRF52840_QIAA=y
CONFIG_BOARD_CORNIX=y
CONFIG_BOARD_CORNIX_RIGHT=y

# ===== 必要外設 / 儲存 =====
CONFIG_ARM_MPU=y
CONFIG_PINCTRL=y
CONFIG_GPIO=y
CONFIG_FLASH=y
CONFIG_FLASH_PAGE_LAYOUT=y
CONFIG_FLASH_MAP=y
CONFIG_USE_DT_CODE_PARTITION=y
CONFIG_MPU_ALLOW_FLASH_WRITE=y
CONFIG_NVS=y
CONFIG_SETTINGS_NVS=y
CONFIG_CLOCK_CONTROL_NRF=y
CONFIG_CLOCK_CONTROL_NRF_K32SRC_RC=y
CONFIG_BUILD_OUTPUT_UF2=y

# ===== ZMK 基本 =====
CONFIG_ZMK_KEYBOARD_NAME="Cornix"
CONFIG_ZMK_BLE=y
CONFIG_ZMK_USB=y          # 建議主半保留 USB，除錯/有線都方便
CONFIG_ZMK_MOUSE=y        # ← 啟用滑鼠鍵 (&mkp / &mmv / &msc)

# ===== 分體設定（右半為 Central）=====
CONFIG_ZMK_SPLIT=y
CONFIG_ZMK_SPLIT_ROLE_CENTRAL=y

# ===== 藍牙 / 電力（可依需求調整）=====
CONFIG_BT_CTLR_TX_PWR_PLUS_8=y
CONFIG_ZMK_BATTERY_REPORT_INTERVAL=60
CONFIG_ZMK_SPLIT_BLE_CENTRAL_BATTERY_LEVEL_PROXY=y
CONFIG_ZMK_SPLIT_BLE_CENTRAL_BATTERY_LEVEL_FETCHING=y

# ===== 其他周邊（依你原檔）=====
CONFIG_INPUT=y
CONFIG_SPI=n
CONFIG_ZMK_EXT_POWER=n
CONFIG_EC11=y
CONFIG_EC11_TRIGGER_GLOBAL_THREAD=y

# 顯示/Studio（依需求）
CONFIG_ZMK_DISPLAY=n
CONFIG_ZMK_HID_REPORT_TYPE_NKRO=n
CONFIG_ZMK_POINTING=y
CONFIG_BT_MAX_CONN=6
CONFIG_BT_MAX_PAIRED=6
CONFIG_ZMK_STUDIO=y
CONFIG_ZMK_STUDIO_LOCKING=n
CONFIG_ZMK_STUDIO_LOCK_ON_DISCONNECT=n
```
